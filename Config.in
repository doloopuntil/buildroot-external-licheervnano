## Config.in
```kconfig
source "$BR2_EXTERNAL_SIPEED_LICHEERV_NANO_PATH/package/aic8800-modules/Config.in"
source "$BR2_EXTERNAL_SIPEED_LICHEERV_NANO_PATH/package/soph-tpu/Config.in"
source "$BR2_EXTERNAL_SIPEED_LICHEERV_NANO_PATH/package/cv1800-mbox-demo/Config.in"
source "$BR2_EXTERNAL_SIPEED_LICHEERV_NANO_PATH/package/sg2002-8051-demo/Config.in"
source "$BR2_EXTERNAL_SIPEED_LICHEERV_NANO_PATH/boot/fsbl-sg200x/Config.in"
source "$BR2_EXTERNAL_SIPEED_LICHEERV_NANO_PATH/boot/fip-sg200x/Config.in"
source "$BR2_EXTERNAL_SIPEED_LICHEERV_NANO_PATH/boot/licheervnano-firmware/Config.in"
```

## boot/fip-sg200x/Config.in
```kconfig
config BR2_TARGET_FIP_SG200X
	bool "fip-sg200x"
	depends on BR2_TARGET_FSBL_SG200X
	depends on BR2_TARGET_OPENSBI
	depends on BR2_TARGET_UBOOT
	depends on BR2_TARGET_LICHEERVNANO_FIRMWARE
	depends on BR2_riscv
	help
	  Assembles the FIP (Firmware Image Package) boot container
	  for Sophgo SG2002. Combines FSBL, OpenSBI, U-Boot, and
	  vendor boot blobs into fip.bin.

	  https://github.com/varyhin/licheervnano
```

## boot/fsbl-sg200x/Config.in
```kconfig
config BR2_TARGET_FSBL_SG200X
	bool "fsbl-sg200x"
	depends on BR2_riscv
	help
	  First Stage Bootloader (BL2) for Sophgo SG2002 (CV181x family).
	  Vendor TF-A fork from Sipeed LicheeRV-Nano-Build, patched for
	  mainline RISC-V toolchain.

	  Outputs cv181x.bin for the FIP container.

	  https://github.com/sipeed/LicheeRV-Nano-Build
```

## boot/licheervnano-firmware/Config.in
```kconfig
config BR2_TARGET_LICHEERVNANO_FIRMWARE
	bool "licheervnano-firmware"
	depends on BR2_riscv
	help
	  Boot firmware blobs and Wi-Fi firmware for the Sipeed LicheeRV Nano:
	  - ddr_param.bin (DDR3 initialization parameters)
	  - cvirtos.bin (FreeRTOS coprocessor firmware)
	  - AIC8800 SDIO Wi-Fi firmware (aic8800_u03, aic8800d80_u02)

	  https://github.com/varyhin/licheervnano
```

## configs/sipeed_licheerv_nano_defconfig
```kconfig
# Architecture
BR2_riscv=y
BR2_RISCV_ISA_RVC=y

# Toolchain
BR2_TOOLCHAIN_BUILDROOT_GLIBC=y
BR2_TOOLCHAIN_BUILDROOT_CXX=y
BR2_KERNEL_HEADERS_6_18=y

# System
BR2_TARGET_GENERIC_HOSTNAME="licheervnano"
BR2_TARGET_GENERIC_ISSUE="Welcome to Buildroot for the Sipeed LicheeRV Nano"
BR2_ROOTFS_DEVICE_CREATION_DYNAMIC_EUDEV=y
BR2_TARGET_GENERIC_GETTY_PORT="ttyS0"
BR2_TARGET_GENERIC_GETTY_BAUDRATE_115200=y
BR2_ROOTFS_OVERLAY="$(BR2_EXTERNAL_SIPEED_LICHEERV_NANO_PATH)/board/licheervnano/rootfs-overlay"
BR2_ROOTFS_POST_IMAGE_SCRIPT="$(BR2_EXTERNAL_SIPEED_LICHEERV_NANO_PATH)/board/licheervnano/post-image.sh"

# Global patch directory
BR2_GLOBAL_PATCH_DIR="$(BR2_EXTERNAL_SIPEED_LICHEERV_NANO_PATH)/board/licheervnano"

# Kernel
BR2_LINUX_KERNEL=y
BR2_LINUX_KERNEL_CUSTOM_VERSION=y
BR2_LINUX_KERNEL_CUSTOM_VERSION_VALUE="6.18.29"
BR2_LINUX_KERNEL_USE_ARCH_DEFAULT_CONFIG=y
BR2_LINUX_KERNEL_CONFIG_FRAGMENT_FILES="$(BR2_EXTERNAL_SIPEED_LICHEERV_NANO_PATH)/board/licheervnano/linux.fragment"
BR2_LINUX_KERNEL_DTS_SUPPORT=y
BR2_LINUX_KERNEL_INTREE_DTS_NAME="sophgo/sg2002-licheerv-nano-b sophgo/sg2002-licheerv-nano-e sophgo/sg2002-licheerv-nano-w sophgo/sg2002-licheerv-nano-we"
BR2_LINUX_KERNEL_NEEDS_HOST_OPENSSL=y

# U-Boot
BR2_TARGET_UBOOT=y
BR2_TARGET_UBOOT_BUILD_SYSTEM_KCONFIG=y
BR2_TARGET_UBOOT_CUSTOM_VERSION=y
BR2_TARGET_UBOOT_CUSTOM_VERSION_VALUE="2025.10"
BR2_TARGET_UBOOT_BOARD_DEFCONFIG="sipeed_licheerv_nano"
BR2_TARGET_UBOOT_FORMAT_DTB=y
BR2_TARGET_UBOOT_NEEDS_OPENSSL=y

# OpenSBI
BR2_TARGET_OPENSBI=y
BR2_TARGET_OPENSBI_CUSTOM_VERSION=y
BR2_TARGET_OPENSBI_CUSTOM_VERSION_VALUE="1.8.1"
BR2_TARGET_OPENSBI_PLAT="generic"
BR2_TARGET_OPENSBI_INSTALL_DYNAMIC_IMG=y
BR2_TARGET_OPENSBI_UBOOT_PAYLOAD=y
BR2_TARGET_OPENSBI_FW_FDT_PATH=y

# Boot firmware and blobs
BR2_TARGET_LICHEERVNANO_FIRMWARE=y
BR2_TARGET_FSBL_SG200X=y
BR2_TARGET_FIP_SG200X=y

# Kernel modules
BR2_PACKAGE_AIC8800_MODULES=y
BR2_PACKAGE_SOPH_TPU=y

# Filesystem
BR2_TARGET_ROOTFS_EXT2=y
BR2_TARGET_ROOTFS_EXT2_4=y
BR2_TARGET_ROOTFS_EXT2_SIZE="256M"

# Host tools for image generation
BR2_PACKAGE_HOST_GENIMAGE=y
BR2_PACKAGE_HOST_MTOOLS=y
BR2_PACKAGE_HOST_DOSFSTOOLS=y

# System packages
BR2_PACKAGE_OPENSSH=y
BR2_PACKAGE_WPA_SUPPLICANT=y
BR2_PACKAGE_WPA_SUPPLICANT_CLI=y
BR2_PACKAGE_WPA_SUPPLICANT_PASSPHRASE=y
BR2_PACKAGE_IW=y
BR2_PACKAGE_WIRELESS_REGDB=y
BR2_PACKAGE_BLUEZ5_UTILS=y
BR2_PACKAGE_ZLIB=y
BR2_PACKAGE_I2C_TOOLS=y
BR2_PACKAGE_ALSA_UTILS=y
BR2_PACKAGE_ETHTOOL=y
BR2_PACKAGE_IPROUTE2=y
BR2_PACKAGE_DHCPCD=y
```

## package/aic8800-modules/Config.in
```kconfig
config BR2_PACKAGE_AIC8800_MODULES
	bool "aic8800-modules"
	depends on BR2_LINUX_KERNEL
	depends on BR2_riscv
	help
	  AIC8800D80 SDIO Wi-Fi 6 and Bluetooth 5 kernel modules for
	  Sipeed LicheeRV Nano-W/WE boards.

	  Builds three modules: aic8800_bsp.ko, aic8800_fdrv.ko,
	  aic8800_btlpm.ko. Forward-ported from vendor 5.10 to mainline 6.18.

	  https://github.com/varyhin/licheervnano
```

## package/cv1800-mbox-demo/Config.in
```kconfig
config BR2_PACKAGE_CV1800_MBOX_DEMO
	bool "cv1800-mbox-demo"
	depends on BR2_LINUX_KERNEL
	depends on BR2_riscv
	help
	  Kernel module and userspace test program demonstrating
	  SG2002 hardware mailbox (sophgo,cv1800b-mailbox) for
	  inter-core IPC between C906B (Linux), C906L (RTOS),
	  and 8051.

	  Load: modprobe cv1800_mbox_demo
	  Test: mbox-demo
```

## package/sg2002-8051-demo/Config.in
```kconfig
config BR2_PACKAGE_SG2002_8051_DEMO
	bool "sg2002-8051-demo"
	depends on BR2_riscv
	help
	  8051 mailbox echo demo for SG2002 SoC. Includes pre-compiled
	  8051 firmware (mailbox echo) and a Linux loader program that
	  starts the 8051 core and demonstrates bidirectional IPC via
	  the hardware mailbox (0x01900000).

	  Test: 8051-mbox-loader
```

## package/soph-tpu/Config.in
```kconfig
config BR2_PACKAGE_SOPH_TPU
	bool "soph-tpu"
	depends on BR2_LINUX_KERNEL
	depends on BR2_riscv
	help
	  Cvitek/Sophgo TPU (NPU) kernel driver for SG2002 (0.5 TOPS INT8).
	  Forward-ported from vendor 5.10 kernel to mainline 6.18.

	  Builds soph_tpu.ko. Required for on-chip AI inference.

	  https://github.com/varyhin/licheervnano
```
